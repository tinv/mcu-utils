## lib/Kconfig
```kconfig
# Copyright (c) 2024 TecInvent Electronics Ltd.
# SPDX-License-Identifier: Apache-2.0

menu "MCU utils libraries"

rsource "gpio/Kconfig"
rsource "codec/Kconfig"
rsource "time/Kconfig"
rsource "utils/Kconfig"
rsource "leds/Kconfig"
rsource "storage/Kconfig"

endmenu
```

## lib/adc/Kconfig
```kconfig
# Copyright (c) 2025, TecInvent Electronics Ltd
# SPDX-License-Identifier: Apache-2.0

config MCU_UTILS_ADC
	bool "Support for mcu utils adc library"
	help
	  This option enables the 'mcu utils adc' library
```

## lib/bus/Kconfig
```kconfig
# Copyright (c) 2026, TecInvent Electronics Ltd

config MCU_UTILS_BUS
	bool "Support for mcu utils bus library"
	help
	  This option enables the 'mcu utils bus' library
	select ZBUS
	select ZBUS_RUNTIME_OBSERVERS
	select ZBUS_MSG_SUBSCRIBER
```

## lib/codec/Kconfig
```kconfig
# Copyright (c) 2024, TecInvent Electronics Ltd
# SPDX-License-Identifier: Apache-2.0

config MCU_UTILS_CODEC
	bool "Support for mcu utils codec library"
	help
	  This option enables the 'mcu utils codec' library
```

## lib/fs/Kconfig
```kconfig
# Copyright (c) 2025, TecInvent Electronics Ltd
# SPDX-License-Identifier: Apache-2.0

config MCU_UTILS_FS
	bool "Support for mcu utils fs library"
	help
	  This option enables the 'mcu utils fs' library
```

## lib/gpio/Kconfig
```kconfig
# Copyright (c) 2024, TecInvent Electronics Ltd
# SPDX-License-Identifier: Apache-2.0

config MCU_UTILS_GPIO
	bool "Support for mcu utils gpio library"
	help
	  This option enables the 'mcu utils gpio' library
```

## lib/hwid/Kconfig
```kconfig
# Copyright (c) 2024, TecInvent Electronics Ltd
# SPDX-License-Identifier: Apache-2.0

config MCU_UTILS_HWID
	bool "Support for mcu utils hwid library"
	help
	  This option enables the 'mcu utils hwid' library
```

## lib/leds/Kconfig
```kconfig
# Copyright (c) 2025, TecInvent Electronics Ltd
# SPDX-License-Identifier: Apache-2.0

config MCU_UTILS_LEDS
	bool "Support for mcu utils LEDs library"
	help
	  This option enables the 'mcu utils leds' library
```

## lib/rtc/Kconfig
```kconfig
# Copyright (c) 2024, TecInvent Electronics Ltd
# SPDX-License-Identifier: Apache-2.0

config MCU_UTILS_RTC
	bool "Support for mcu utils rtc library"
	help
	  This option enables the 'mcu utils rtc' library
```

## lib/storage/Kconfig
```kconfig
# Copyright (c) 2025, TecInvent Electronics Ltd
# SPDX-License-Identifier: Apache-2.0

config MCU_UTILS_STORAGE
	bool "Support for mcu utils storage library"
	help
	  This option enables the 'mcu utils storage' library
```

## lib/time/Kconfig
```kconfig
# Copyright (c) 2024, TecInvent Electronics Ltd
# SPDX-License-Identifier: Apache-2.0

config MCU_UTILS_TIME
	bool "Support for mcu utils time library"
	help
	  This option enables the 'mcu utils time' library
```

## lib/utils/Kconfig
```kconfig
# Copyright (c) 2024, TecInvent Electronics Ltd
# SPDX-License-Identifier: Apache-2.0

config MCU_UTILS_UTILS
	bool "Support for mcu utils library"
	help
	  This option enables the 'mcu utils utils' library
```

## lib/workqueue/Kconfig
```kconfig
# Copyright (c) 2024, TecInvent Electronics Ltd
# SPDX-License-Identifier: Apache-2.0

config MCU_UTILS_WORKQUEUE
	bool "Support for mcu utils work queue library"
	help
	  This option enables the 'mcu utils work queue' library
```

## tests/unit/testcase.yaml
```yaml
common:
  tags: extensibility
  integration_platforms:
    - native_posix
tests:
  lib.mcu-utils:
    harness: gtest
```

## west.yml
```yaml
# Copyright (c) 2024 TecInvent Electronics Ltd
# SPDX-License-Identifier: Apache-2.0

manifest:
  self:
    west-commands: scripts/west-commands.yml

  remotes:
    - name: zephyrproject-rtos
      url-base: https://github.com/zephyrproject-rtos

  projects:
    - name: zephyr
      remote: zephyrproject-rtos
      revision: v3.7-branch
      import:
        # By using name-allowlist we can clone only the modules that are
        # strictly needed by the application.
        name-allowlist:
          - cmsis      # required by the ARM port
```
